## conf/layer.conf
```bitbake
# We have a conf and classes directory, append to BBPATH
BBPATH .= ":${LAYERDIR}"
# We have recipes-* directories, add to BBFILESS
BBFILES += "${LAYERDIR}/recipes-*/*/*.bb ${LAYERDIR}/recipes-*/*/*.bbappend"

BBFILE_COLLECTIONS += "games-layer"
BBFILE_PATTERN_games-layer := "^${LAYERDIR}/"
BBFILE_PRIORITY_games-layer = "40"

# Set a variable to get to the top of the metadata location
GAMES_BASE := '${@os.path.normpath("${LAYERDIR}/../")}'

LAYERSERIES_COMPAT_games-layer = "krogoth morty pyro rocko sumo"
```
